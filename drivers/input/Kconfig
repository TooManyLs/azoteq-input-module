## dts/bindings/input/azoteq,iqs5xx-common.yaml
```yaml
properties:
  dr-gpios:
    type: phandle-array
    description: "Data Ready (DR) pin for the Azoteq IQS5xx trackpad"

  x-invert:
    type: boolean
    description: "If true, invert reported X-axis data (e.g. to handle board rotations)"

  y-invert:
    type: boolean
    description: "If true, invert reported Y-axis data (e.g. to handle board rotations)"

  no-taps:
    type: boolean
    description: "Disable tap detection/processing if the firmware or driver supports taps."
```

## dts/bindings/input/azoteq,iqs5xx-i2c.yaml
```yaml
description: |
  Sensor driver for the Azoteq IQS5XX trackpad, using the I2C interface

compatible: "azoteq,iqs5xx"

include: ["i2c-device.yaml", "azoteq,iqs5xx-common.yaml"]
```
